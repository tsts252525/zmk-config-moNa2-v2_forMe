## modules/jis_layout_shift/Kconfig
```kconfig
# JIS layout shift (US keycap -> JIS OS layout conversion for &kp)

config ZMK_JIS_LAYOUT_SHIFT
    bool "US -> JIS keycode conversion for &kp"
    default y
    depends on DT_HAS_ZMK_BEHAVIOR_JIS_KEY_PRESS_ENABLED
    help
      Converts &kp keycodes so that a US-layout keyboard types the symbols
      printed on its keycaps when the host OS is configured for the JIS
      (Japanese) layout. Conversion is switched on/off with &tog_ls.

if ZMK_JIS_LAYOUT_SHIFT

config ZMK_JIS_LAYOUT_SHIFT_DEFAULT_ON
    bool "Enable JIS conversion by default"
    default n
    help
      Initial state used when no saved state exists.

config ZMK_JIS_LAYOUT_SHIFT_PERSIST
    bool "Save JIS conversion state across reboots"
    default y
    depends on SETTINGS
    help
      Saves the on/off state after CONFIG_ZMK_SETTINGS_SAVE_DEBOUNCE ms.

config ZMK_JIS_LAYOUT_SHIFT_MAX_HELD
    int "Maximum simultaneously held &kp keys tracked for release"
    default 16
    range 1 64

endif
```

## modules/jis_layout_shift/dts/bindings/behaviors/zmk,behavior-alt-tab-end.yaml
```yaml
description: Releases Left Alt held by zmk,behavior-alt-tab. See src/behavior_alt_tab.c.

compatible: "zmk,behavior-alt-tab-end"

include: zero_param.yaml
```

## modules/jis_layout_shift/dts/bindings/behaviors/zmk,behavior-alt-tab.yaml
```yaml
description: |
  Holds Left Alt (once) and taps the first parameter to open the Alt+Tab
  switcher; while Alt is held, taps the second parameter instead.
  See src/behavior_alt_tab.c.

compatible: "zmk,behavior-alt-tab"

include: two_param.yaml
```

## modules/jis_layout_shift/dts/bindings/behaviors/zmk,behavior-jis-key-press.yaml
```yaml
description: |
  Layout-aware key press. Behaves exactly like &kp while JIS mode is off;
  while it is on, converts US-layout symbol keycodes to the keycodes that
  produce the same symbols on a JIS-layout OS.

compatible: "zmk,behavior-jis-key-press"

include: one_param.yaml
```

## modules/jis_layout_shift/dts/bindings/behaviors/zmk,behavior-jis-layout-toggle.yaml
```yaml
description: Switches US -> JIS keycode conversion on/off

compatible: "zmk,behavior-jis-layout-toggle"

include: zero_param.yaml

properties:
  mode:
    type: string
    default: "toggle"
    enum:
      - "toggle"
      - "on"
      - "off"
```

## modules/jis_layout_shift/dts/bindings/input_processors/zmk,input-processor-xy-block.yaml
```yaml
description: |
  Input processor that drops pointer REL_X / REL_Y events (keeps the cursor
  still). Scroll (WHEEL/HWHEEL) and buttons pass through. See
  src/input_processor_xy_block.c.

compatible: "zmk,input-processor-xy-block"

include: ip_zero_param.yaml
```
